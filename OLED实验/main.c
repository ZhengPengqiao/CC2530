/*****************************************************************************
*  项目名称  ： OLED实验
*    作者    ： 郑朋桥
*    时间    ： 2016/08/08
******************************************************************************/

/*****************************************************************************
*  添加头文件
******************************************************************************/

#include <ioCC2530.h>
#include "LCD.h"
#include "datafile.h"

/*****************************************************************************
*函数含义：不精确延迟函数
*函数参数：延迟毫秒数
*  返回值：无返回值
*****************************************************************************/
void delayMS(int ms)
{
  int i,j;
  for(i = 0; i < ms; i++)
  {
    for(j = 0; j < 535; j++);
  }
}

void main()
{

    unsigned int i=0; 
    LCD_Init();                      //oled 初始化  
    LCD_Fill(0xff);                  //屏全亮 
    
    while(1)
    {
        LCD_CLS();
        test8x16();
        for(i=0; i<8; i++)
        {
            LCD_P16x16Ch(i*16,0,i);  //点阵显示
            LCD_P16x16Ch(i*16,2,i+8);
            LCD_P16x16Ch(i*16,4,i+16);
            LCD_P16x16Ch(i*16,6,i+24);
        } 
        delayMS(1000); 
        LCD_CLS();   
        LCD_P8x16Str(44,0,"saler");   
        LCD_P8x16Str(20,2,"OLED DISPLAY");   

        LCD_P8x16Str(8,4,"TEL:13088850665"); 
        LCD_P6x8Str(20,6,"ald16888@163.com");       
        LCD_P6x8Str(20,7,"2013-01-10 18:18");    
        delayMS(1000);  
        
        LCD_CLS();
        Draw_BMP(0,0,128,8,BMP);     //图片显示
        delayMS(1000);  
    }
}   

