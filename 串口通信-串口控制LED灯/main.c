/*****************************************************************************
*  项目名称  ： 串口通信-串口控制LED灯
*    作者    ： 郑朋桥
*    时间    ： 2106/08/05
******************************************************************************/

/*****************************************************************************
*  添加头文件
******************************************************************************/

#include <ioCC2530.h>
#include <string.h>
#include "INTUART.h"
#include "LED.h"
#include "UARTCMDRUN.h"

char str[5];
int countRX = 0;
int countTX = 0;

/*****************************************************************************
*函数含义：不精确延迟函数
*函数参数：延迟毫秒数
*  返回值：无返回值
*****************************************************************************/
void delayMS(int ms)
{
  int i,j;
  for(i = 0; i < ms; i++)
  {
    for(j = 0; j < 535; j++);
  }
}

/*****************************************************************************
*  函数介绍  ： 接收晚餐时进行的函数处理
*            ：
*    参数    ： 无
*   返回值   ： 无
******************************************************************************/
void RXISR_function()
{
  countRX++;
}

/*****************************************************************************
*  函数介绍  ： 发送完成时的函数处理
*            ：
*    参数    ： 无
*   返回值   ： 无
******************************************************************************/


void TXISR_function()
{
  countTX++;
}


/*****************************************************************************
*  函数介绍  ： A0#指令的运行函数
*            ：
*    参数    ： 无
*   返回值   ： 无
******************************************************************************/
void A0UartCmdFun()
 {
   led1Off();
   led2Off();
 }

/*****************************************************************************
*  函数介绍  ： A1#指令的运行函数
*            ：
*    参数    ： 无
*   返回值   ： 无
******************************************************************************/
 void A1UartCmdFun()
 {
   led1On();
   led2On();
 }

void main()
{
  int count;

  setSystemCLK();                  //初始化系统时钟
  initUartCmd();
  ledInit();                       //初始化LED
  initUart();                      //初始化串口
  setUART0_RXISR(RXISR_function);  //设置接收完成时的函数
  setUART0_TXISR(TXISR_function);  //设置发送完成时的函数
  //添加命令和对应的映射函数  
  addUartCmd("D1#", led1On);
  addUartCmd("d1#", led1Off);
  addUartCmd("D2#", led2On);
  addUartCmd("d2#", led2Off);
  addUartCmd("A0#", A0UartCmdFun);
  addUartCmd("A1#", A1UartCmdFun);
  deleteUartCmd("A0#");
  addUartCmd("A0#", A0UartCmdFun);
  while(1)
  { 
    sendString("aa",2);
    memset(str,0,5);  
    count = readString(str,5);
    sendString(str,count);
    
    runUartCmd(str);      //运行str命令

    delayMS(1000);
  }
}
